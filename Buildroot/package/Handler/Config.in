## Buildroot/package/Pyranometer/Config.in
```kconfig
config BR2_PACKAGE_PYRANOMETER
    bool "pyranometer"
    help
      pyranometer package
```

## Buildroot/package/WindSensor/Config.in
```kconfig
config BR2_PACKAGE_WINDSENSOR
    bool "windSensor"
    help
      windSensor package
```

## Buildroot/package/YOUR_SENSOR/Config.in
```kconfig
config BR2_PACKAGE_YOUR_SENSOR
    bool "your_sensor"
    help
      your_sensor package
```
